## releases/2026-09-25-v41-uboot-recovery/recovery.its
```
/dts-v1/;

/ {
	description = "BE6500 v41 U-Boot recovery";

	images {
		script {
			description = "flash.scr";
			data = /incbin/("flash.scr");
			type = "script";
			arch = "arm";
			compression = "none";

			hash@1 {
				algo = "crc32";
			};
		};

		hlos-v41 {
			description = "boot-confirmed v41 HLOS FIT";
			data = /incbin/("v41-kernel.itb");
			type = "firmware";
			arch = "arm";
			compression = "none";

			hash@1 {
				algo = "crc32";
			};
		};

		rootfs-v41 {
			description = "boot-confirmed v41 SquashFS";
			data = /incbin/("v41-root.squashfs");
			type = "firmware";
			arch = "arm";
			compression = "none";

			hash@1 {
				algo = "crc32";
			};
		};
	};
};
```
