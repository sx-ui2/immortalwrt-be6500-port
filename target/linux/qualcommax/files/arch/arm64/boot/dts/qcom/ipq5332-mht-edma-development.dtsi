// SPDX-License-Identifier: (GPL-2.0+ OR BSD-3-Clause)
/* Native QSDK 6.6 MHT EDMA allocation, from e313f146 ipq5332-rdp468.dts.
 * This is a driver resource layout, NOT a physical-port mapping.
 * Reserve PPEDS/loopback slots like the reference; radios remain disabled.
 */
&{/soc@0/edma@3ab00000} {
	status = "okay";
	qcom,txdesc-ring-start = <4>;
	qcom,txdesc-rings = <12>;
	qcom,mht-txdesc-rings = <8>;
	qcom,txcmpl-ring-start = <4>;
	qcom,txcmpl-rings = <12>;
	qcom,mht-txcmpl-rings = <8>;
	qcom,rxfill-ring-start = <4>;
	qcom,rxfill-rings = <4>;
	qcom,rxdesc-ring-start = <12>;
	qcom,rxdesc-rings = <4>;
	qcom,rx-page-mode = <0>;
	qcom,tx-map-priority-level = <1>;
	qcom,rx-map-priority-level = <1>;
	qcom,num_loopback_rings = <1>;
	qcom,txdesc_loopback_ring_id = <0>;
	qcom,txcmpl_loopback_ring_id = <0>;
	qcom,rxfill_loopback_ring_id = <0>;
	qcom,rxdesc_loopback_ring_id = <0>;
	qcom,loopback_queue_base = <56>;
	qcom,loopback_num_queues = <8>;
	qcom,ppeds-num = <2>;
	qcom,ppeds-map = <1 1 1 1 32 8>, <2 2 2 2 40 8>;
	qcom,txdesc-map = <8 9 10 11>, <12 13 14 15>, <4 5 6 7>,
		<16 17 18 19>, <20 21 22 23>;
	qcom,txdesc-fc-grp-map = <1 2 3 4 5>;
	qcom,rxfill-map = <4 5 6 7>;
	qcom,rxdesc-map = <12 13 14 15>;
	qcom,rx-queue-start = <0>;
	qcom,rx-ring-queue-map = <0 8 16 24>, <1 9 17 25>, <2 10 18 26>,
		<3 11 19 27>, <4 12 20 28>, <5 13 21 29>, <6 14 22 30>, <7 15 23 31>;
	interrupts = <GIC_SPI 163 IRQ_TYPE_LEVEL_HIGH>,
		<GIC_SPI 164 IRQ_TYPE_LEVEL_HIGH>, <GIC_SPI 165 IRQ_TYPE_LEVEL_HIGH>,
		<GIC_SPI 166 IRQ_TYPE_LEVEL_HIGH>, <GIC_SPI 167 IRQ_TYPE_LEVEL_HIGH>,
		<GIC_SPI 168 IRQ_TYPE_LEVEL_HIGH>, <GIC_SPI 169 IRQ_TYPE_LEVEL_HIGH>,
		<GIC_SPI 170 IRQ_TYPE_LEVEL_HIGH>, <GIC_SPI 171 IRQ_TYPE_LEVEL_HIGH>,
		<GIC_SPI 172 IRQ_TYPE_LEVEL_HIGH>, <GIC_SPI 173 IRQ_TYPE_LEVEL_HIGH>,
		<GIC_SPI 174 IRQ_TYPE_LEVEL_HIGH>,
		<GIC_SPI 139 IRQ_TYPE_LEVEL_HIGH>, <GIC_SPI 140 IRQ_TYPE_LEVEL_HIGH>,
		<GIC_SPI 141 IRQ_TYPE_LEVEL_HIGH>, <GIC_SPI 142 IRQ_TYPE_LEVEL_HIGH>,
		<GIC_SPI 191 IRQ_TYPE_LEVEL_HIGH>,
		<GIC_SPI 155 IRQ_TYPE_LEVEL_HIGH>, <GIC_SPI 156 IRQ_TYPE_LEVEL_HIGH>,
		<GIC_SPI 157 IRQ_TYPE_LEVEL_HIGH>, <GIC_SPI 158 IRQ_TYPE_LEVEL_HIGH>,
		<GIC_SPI 160 IRQ_TYPE_LEVEL_HIGH>, <GIC_SPI 128 IRQ_TYPE_LEVEL_HIGH>,
		<GIC_SPI 152 IRQ_TYPE_LEVEL_HIGH>, <GIC_SPI 161 IRQ_TYPE_LEVEL_HIGH>,
		<GIC_SPI 129 IRQ_TYPE_LEVEL_HIGH>, <GIC_SPI 153 IRQ_TYPE_LEVEL_HIGH>,
		<GIC_SPI 175 IRQ_TYPE_LEVEL_HIGH>, <GIC_SPI 176 IRQ_TYPE_LEVEL_HIGH>,
		<GIC_SPI 177 IRQ_TYPE_LEVEL_HIGH>, <GIC_SPI 178 IRQ_TYPE_LEVEL_HIGH>,
		<GIC_SPI 179 IRQ_TYPE_LEVEL_HIGH>, <GIC_SPI 180 IRQ_TYPE_LEVEL_HIGH>,
		<GIC_SPI 181 IRQ_TYPE_LEVEL_HIGH>, <GIC_SPI 182 IRQ_TYPE_LEVEL_HIGH>;
};
